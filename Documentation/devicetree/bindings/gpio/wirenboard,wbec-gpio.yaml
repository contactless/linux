## Documentation/devicetree/bindings/gpio/wirenboard,wbec-gpio.yaml
```yaml
# SPDX-License-Identifier: (GPL-2.0 OR BSD-2-Clause)
# Copyright 2019 Bootlin
%YAML 1.2
---
$id: "http://devicetree.org/schemas/gpio/wirenboard,wbec-gpio.yaml#"
$schema: "http://devicetree.org/meta-schemas/core.yaml#"

title: Wiren Board Embedded Controller GPIO Driver

maintainers:
  - Pavel Gasheev <pavel.gasheev@wirenboard.com>

description: |
  The WB EC GPIO describes the GPIO block included in the WB EC.

  The driver exposes GPIOs from the WB EC.
  For GPIO description look at WB EC firmware.
  Current GPIOs are:
  - [3:0] - A1-A4 inputs
  - [4] - V_OUT control
  - [5] - WBMZ Status

properties:
  compatible:
    const: wirenboard,wbec-gpio

  reg:
    const: 0

  "#gpio-cells":
    const: 2

  gpio-controller: true

  ngpios:
    minimum: 1
    description:
      Number of GPIOs

  gpio-line-names:
    minItems: 1

required:
  - compatible
  - reg
  - "#gpio-cells"
  - gpio-controller
  - ngpios

additionalProperties: false

examples:
  - |
    wbec_gpio: wbec-gpio@0 {
      compatible = "wirenboard,wbec-gpio";
      reg = <0>;

      gpio-controller;
      #gpio-cells = <2>;
      ngpios = <6>;
      gpio-line-names = "EC A1", "EC A2", "EC A3", "EC A4", "EC V OUT", "EC WBMZ STATUS";
    };
```

## Documentation/devicetree/bindings/iio/adc/wirenboard,wbec-adc.yaml
```yaml
# SPDX-License-Identifier: (GPL-2.0 OR BSD-2-Clause)
%YAML 1.2
---
$id: http://devicetree.org/schemas/iio/adc/wirenboard,wbec-adc.yaml#
$schema: http://devicetree.org/meta-schemas/core.yaml#

title: Wiren Board Embedded Controller ADC Driver

maintainers:
  - Pavel Gasheev <pavel.gasheev@wirenboard.com>

description: |
  The WB EC ADC describes the ADC block included in the WB EC.
  The driver produces next IIO channels:
  [0] - Voltage on Vin terminal in mV
  [1] - Voltage on 3.3V bus in mV
  [2] - Voltage on 5V bus in mV
  [3] - Voltage on USB debug console in mV
  [4] - Voltage on USB debug network in mV
  [5] - Board temperature in deg C
  [6..11] - ADC1..ADC6 channels in mV after divider (on WB EC pin)

properties:
  compatible:
    const: wirenboard,wbec-adc

  reg:
    const: 0

  "#io-channel-cells":
    const: 1

required:
  - compatible
  - reg
  - "#io-channel-cells"

additionalProperties: false

examples:
  - |
    wbec_adc: wbec-adc@0 {
      compatible = "wirenboard,wbec-adc";
      reg = <0>;
      #io-channel-cells = <1>;
    };
...
```

## Documentation/devicetree/bindings/input/wirenboard,wbec-pwrkey.yaml
```yaml
# SPDX-License-Identifier: GPL-2.0
%YAML 1.2
---
$id: http://devicetree.org/schemas/input/wirenboard,wbec-pwrkey.yaml#
$schema: http://devicetree.org/meta-schemas/core.yaml#

title: Wiren Board Embedded Controller Power Button Driver

maintainers:
  - Pavel Gasheev <pavel.gasheev@wirenboard.com>

description: |
  Enables Power Button support on the Wiren Board Embedded Controller.

properties:
  compatible:
    const: wirenboard,wbec-pwrkey

  reg:
    const: 0

required:
  - compatible
  - reg

additionalProperties: false

examples:
  - |
    wbec-pwrkey@0 {
      compatible = "wirenboard,wbec-pwrkey";
      reg = <0>;
    };
...
```

## Documentation/devicetree/bindings/power/supply/edlc-battery.yaml
```yaml
# SPDX-License-Identifier: (GPL-2.0 OR BSD-2-Clause)
# Copyright 2021 Evgeny Boger
%YAML 1.2
---
$id: "http://devicetree.org/schemas/power/supply/ingenic,battery.yaml#"
$schema: "http://devicetree.org/meta-schemas/core.yaml#"

title: Generic EDLC battery bindings

maintainers:
  - Evgeny Boger <boger@wirenboard.com>

properties:
  compatible:
      - const: edlc-battery

  io-channels:
    maxItems: 1

  io-channel-names:
    const: voltage

  monitored-battery:
    description: >
      phandle to a "simple-battery" compatible node.

      This property, if provided, must be a phandle to a node usin
      the format described in battery.yaml, with the following properties
      supported (all optional):
      - voltage-max-design-microvolt: fully charged supercapacitor voltage,
      - voltage-min-design-microvolt: drained supercapacitor voltage,
      - energy-full-design-microwatt-hours: supercapacitor design energy in mWh.

required:
  - compatible
  - io-channels
  - io-channel-names

additionalProperties: false

examples:
  - |
    simple_battery_1: battery {
            compatible = "simple-battery";
            voltage-min-design-microvolt = <2000000>;
            voltage-max-design-microvolt = <5000000>;
            energy-full-design-microwatt-hours = <150000>;
    };

    eldc-battery {
            compatible = "edlc-battery";
            io-channels = <&adc 12>;
            io-channel-names = "voltage";
            monitored-battery = <&simple_battery_1>;
    };
  - |
    simple_battery_2: battery {
            compatible = "simple-battery";
            voltage-max-design-microvolt = <5000000>;
            energy-full-design-microwatt-hours = <150000>;
    };

    eldc-battery {
            compatible = "edlc-battery";
            io-channels = <&adc 12>;
            io-channel-names = "voltage";
            monitored-battery = <&simple_battery_2>;
    };
  - |
    simple_battery_3: battery {
            compatible = "simple-battery";
            energy-full-design-microwatt-hours = <150000>;
    };

    eldc-battery {
            compatible = "edlc-battery";
            io-channels = <&adc 12>;
            io-channel-names = "voltage";
            monitored-battery = <&simple_battery_3>;
    };
  - |
    eldc-battery {
            compatible = "edlc-battery";
            io-channels = <&adc 12>;
            io-channel-names = "voltage";
    };
```

## Documentation/devicetree/bindings/power/supply/wirenboard,wbec-battery.yaml
```yaml
# SPDX-License-Identifier: GPL-2.0
%YAML 1.2
---
$id: http://devicetree.org/schemas/power/supply/wirenboard,wbec-battery.yaml#
$schema: http://devicetree.org/meta-schemas/core.yaml#

title: Wiren Board Embedded Controller Battery Driver

maintainers:
  - Pavel Gasheev <pavel.gasheev@wirenboard.com>

description: |
  Enables WBMZ6-* battery support on the Wiren Board Embedded Controller.

properties:
  compatible:
    const: wirenboard,wbec-battery

  reg:
    const: 0

required:
  - compatible
  - reg

additionalProperties: false

examples:
  - |
    wbec-battery@0 {
      compatible = "wirenboard,wbec-battery";
      reg = <0>;
    };
...
```

## Documentation/devicetree/bindings/power/wirenboard,wbec-power.yaml
```yaml
# SPDX-License-Identifier: (GPL-2.0 OR BSD-2-Clause)
%YAML 1.2
---
$id: http://devicetree.org/schemas/power/wirenboard,wbec-power.yaml#
$schema: http://devicetree.org/meta-schemas/core.yaml#

title: Wiren Board Embedded Controller Power Supply Driver

maintainers:
  - Pavel Gasheev <pavel.gasheev@wirenboard.com>

description: |
  The driver provides power supply class for the Wiren Board.

properties:
  compatible:
    const: wirenboard,wbec-power

  reg:
    const: 0

required:
  - compatible
  - reg

additionalProperties: false

examples:
  - |
    vin: wbec-power@0 {
      compatible = "wirenboard,wbec-power";
      reg = <0>;
    };
...
```

## Documentation/devicetree/bindings/pwm/pwm-sun8i.txt
```
Allwinner sun8i R40/V40/T3 SoC PWM controller

Required properties:
  - compatible: Should be one of:
    - "allwinner,sun8i-r40-pwm"
  - reg: Physical base address and length of the controller's registers
  - interrupts: Should contain interrupt.
  - clocks: From common clock binding, handle to the parent clock.
  - clock-names: Must contain the clock names described just above.
  - pwm-channels: PWM channels of the controller.
  - #pwm-cells: Should be 3. See pwm.txt in this directory for a description of
    the cells format.

Example:

pwm: pwm@1c23400 {
	     compatible = "allwinner,sun8i-r40-pwm";
	     reg = <0x01c23400 0x400>;
	     interrupts = <GIC_SPI 47 IRQ_TYPE_LEVEL_HIGH>;
	     clocks = <&osc24M>, <&ccu CLK_APB1>;
	     clock-names = "mux-0", "mux-1";
	     pwm-channels = <8>;
	     #pwm-cells = <3>;
};
```

## Documentation/devicetree/bindings/pwm/wirenboard,wbec-pwm.yaml
```yaml
# SPDX-License-Identifier: GPL-2.0
%YAML 1.2
---
$id: http://devicetree.org/schemas/pwm/wirenboard,wbec-pwm.yaml#
$schema: http://devicetree.org/meta-schemas/core.yaml#

title: Wiren Board Embedded Controller PWM Driver

maintainers:
  - Pavel Gasheev <pavel.gasheev@wirenboard.com>

description: |
  Enables PWM (buzzer) support on the Wiren Board Embedded Controller.

properties:
  compatible:
    const: wirenboard,wbec-pwm

  reg:
    const: 0

required:
  - compatible
  - reg

additionalProperties: false

examples:
  - |
    wbec-pwm@0 {
      compatible = "wirenboard,wbec-pwm";
      reg = <0>;
      #pwm-cells = <3>;
    };
...
```

## Documentation/devicetree/bindings/regulator/allwinner,h616-mmc-regulator.yaml
```yaml
# SPDX-License-Identifier: (GPL-2.0+ OR MIT)

%YAML 1.2
---
$id: "http://devicetree.org/schemas/regulator/allwinner,h616-mmc-regulator.yaml#"
$schema: "http://devicetree.org/meta-schemas/core.yaml#"

title: Allwinner H616 MMC Regulator

maintainers:
  - Anton Tarasov <anton.tarasov@wirenboard.com>

description: |
  This driver supports the built-in MMC voltage regulator of the 
  Allwinner H616 processor, which allows switching voltage levels 
  on data lines without using any external regulators. 
  The regulator is required to switch the voltage from 3.3V to 1.8V 
  on the data lines to support high-speed SD-UHS modes for MicroSD.
  Without the regulator, the MicroSD will operate only in slow-modes.

properties:
  compatible:
    const: allwinner,h616-mmc-regulator

  syscon:
    description: Phandle to the system controller (syscon) node.

required:
  - compatible
  - syscon

additionalProperties: false

examples:
  - |
    mmc_regulator: regulator@0 {
      compatible = "allwinner,h616-mmc-regulator";
      syscon = <&syscon>;
      regulator-name = "h616-mmc-vqmmc";
      regulator-min-microvolt = <1800000>;
      regulator-max-microvolt = <3300000>;
    };
```

## Documentation/devicetree/bindings/rtc/wirenboard,wbec-rtc.yaml
```yaml
# SPDX-License-Identifier: GPL-2.0
%YAML 1.2
---
$id: http://devicetree.org/schemas/rtc/wirenboard,wbec-rtc.yaml#
$schema: http://devicetree.org/meta-schemas/core.yaml#

title: Wiren Board Embedded Controller RTC Driver

maintainers:
  - Pavel Gasheev <pavel.gasheev@wirenboard.com>

description: |
  Enables access to the Real Time Clock (RTC) on the Wiren Board Embedded Controller.

properties:
  compatible:
    const: wirenboard,wbec-rtc

  reg:
    const: 0

  wakeup-source: true

required:
  - compatible
  - reg
  - wakeup-source

additionalProperties: false

examples:
  - |
    rtc_onboard: wbec-rtc@0 {
      compatible = "wirenboard,wbec-rtc";
      reg = <0>;

      wakeup-source;
    };
...
```

## Documentation/devicetree/bindings/serial/wirenboard,wbec-uart.yaml
```yaml
# SPDX-License-Identifier: GPL-2.0
%YAML 1.2
---
$id: http://devicetree.org/schemas/serial/wirenboard,wbec-uart.yaml#
$schema: http://devicetree.org/meta-schemas/core.yaml#

title: Wiren Board Embedded Controller SPI-UART Driver

maintainers:
  - Pavel Gasheev <pavel.gasheev@wirenboard.com>

description: |
  Enables SPI-UART support on the Wiren Board Embedded Controller.

properties:
  compatible:
    const: wirenboard,wbec-uart

  reg:
    const: [ 0, 1 ]

required:
  - compatible
  - reg

additionalProperties: false

examples:
  - |
    wbec_uart_mod1: serial@0 {
      compatible = "wirenboard,wbec-uart";
      reg = <0>;

      status = "disabled";
    };

    wbec_uart_mod2: serial@1 {
      compatible = "wirenboard,wbec-uart";
      reg = <1>;

      status = "disabled";
    };
...
```

## Documentation/devicetree/bindings/w1/w1-gpio.txt
```
w1-gpio devicetree bindings

Required properties:

 - compatible: "w1-gpio"
 - gpios: one or two GPIO specs:
		- the first one is used as data I/O pin
		- the second one is optional. If specified, it is used as
		  enable pin for an external pin pullup.

Optional properties:

 - linux,open-drain: if specified, the data pin is considered in
		     open-drain mode.

Also refer to the generic w1.txt document.

 - pu-gpios: optional GPIO to control external "strong pull-up" FET.
			 if not specified, data I/O pin will be used in output mode to
			 emulate strong pull-up.
Examples:

	onewire {
		compatible = "w1-gpio";
		gpios = <&gpio 0 GPIO_ACTIVE_HIGH>;
		pu-gpios = <&gpio 123 0>;

		battery {
			// ...
		};
	};
```

## Documentation/devicetree/bindings/watchdog/wirenboard,wbec-watchdog.yaml
```yaml
# SPDX-License-Identifier: GPL-2.0
%YAML 1.2
---
$id: http://devicetree.org/schemas/bindings/watchdog/wirenboard,wbec-watchdog.yaml#
$schema: http://devicetree.org/meta-schemas/core.yaml#

title: Wiren Board Embedded Controller Watchdog Driver

maintainers:
  - Pavel Gasheev <pavel.gasheev@wirenboard.com>

description: |
  Enables Watchdog support on the Wiren Board Embedded Controller.

properties:
  compatible:
    const: wirenboard,wbec-watchdog

  reg:
    const: 0

required:
  - compatible
  - reg

additionalProperties: false

examples:
  - |
    wbec-watchdog@0 {
      compatible = "wirenboard,wbec-watchdog";
      reg = <0>;
    };
...
```
