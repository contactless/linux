## Documentation/devicetree/bindings/mfd/wirenboard,wbec.yaml
```yaml
# SPDX-License-Identifier: GPL-2.0-only OR BSD-2-Clause
%YAML 1.2
---
$id: http://devicetree.org/schemas/mfd/wirenboard,wbec.yaml#
$schema: http://devicetree.org/meta-schemas/core.yaml#

title: Wiren Board Embedded Controller

maintainers:
  - Pavel Gasheev <pavel.gasheev@wirenboard.com>

description: |
  Wiren Board Embedded Controller (WB EC, wbec) is an MCU with special firmware
  installed on Wiren Board Automation Controller since HW revision 7.4.
  WB EC is MFD device and provides such function as RTC, WDT, GPIO, ADC, PWRKEY.

properties:
  compatible:
    const: wirenboard,wbec

  reg:
    const: 0

  "#address-cells":
    const: 1

  "#size-cells":
    const: 0

  spi-max-frequency:
    maximum: 1000000
    description: |
      Maximum frequency for SPI bus.

  wakeup-source: true

  wirenboard,suspend-magic-rtc:
    $ref: /schemas/types.yaml#/definitions/phandle
    description:
      Phandle to the Allwinner sun6i RTC whose general-purpose data register 0
      (GP_DATA0, at offset 0x100 from the RTC register base) is used to hand the
      platform firmware (BL31) the magic value that selects the deepest,
      power-off suspend-to-off path. Present only on boards whose firmware
      implements that path (H616/T507, Wiren Board 8); when absent the driver
      leaves the EC-coordinated power-off suspend feature disabled.

required:
  - compatible
  - reg
  - "#address-cells"
  - "#size-cells"
  - wakeup-source
  - spi-max-frequency

additionalProperties: false

examples:
  - |
    &spi2 {
      pinctrl-0 = <&spi2_pb_pins>,
                  <&spi2_cs0_pb_pin>;
      pinctrl-names = "default";
      status = "okay";

      wbec: wbec@0 {
        spi-max-frequency = <1000000>;

        compatible = "wirenboard,wbec";
        reg = <0>;
        status = "okay";
        #address-cells = <1>;
        #size-cells = <0>;

        wakeup-source;

        wbec_gpio: wbec-gpio@0 {
          compatible = "wirenboard,wbec-gpio";
          reg = <0>;

          gpio-controller;
          #gpio-cells = <2>;
          ngpios = <5>;
          gpio-line-names = "EC A1", "EC A2", "EC A3", "EC A4", "EC V OUT";
        };

        wbec_adc: wbec-adc@0 {
          compatible = "wirenboard,wbec-adc";
          reg = <0>;
          #io-channel-cells = <1>;
        };

        vin: wbec-power@0 {
          compatible = "wirenboard,wbec-power";
          reg = <0>;
        };
      };
    };
```

## Documentation/devicetree/bindings/net/can/holtek,ht42b416.yaml
```yaml
# SPDX-License-Identifier: (GPL-2.0-only OR BSD-2-Clause)
%YAML 1.2
---
$id: http://devicetree.org/schemas/net/can/holtek,ht42b416.yaml#
$schema: http://devicetree.org/meta-schemas/core.yaml#

title: Holtek HT42B416 UART to CAN bus bridge

maintainers:
  - Anton Tarasov <anton.tarasov@wirenboard.com>

description:
  The Holtek HT42B416-x devices expose a CAN 2.0A/B controller via a UART
  interface. The controller is configured with ASCII commands terminated by
  carriage return characters and is normally attached to a SoC UART using the
  serdev framework.

allOf:
  - $ref: /schemas/net/can/can-controller.yaml#

properties:
  compatible:
    const: holtek,ht42b416

  current-speed:
    description: UART baud rate used to communicate with the bridge.
    default: 115200

  enable-gpios:
    maxItems: 1
    description:
      Optional GPIO used to drive the CE pin of the bridge. The line should be
      driven high to enable the device and low to reset or power it down.

required:
  - compatible

unevaluatedProperties: false

examples:
  - |
    #include <dt-bindings/gpio/gpio.h>

    &uart4 {
        pinctrl-names = "default";
        pinctrl-0 = <&pinctrl_mod3_txrx_uart>;
        status = "okay";

        can@0 {
            compatible = "holtek,ht42b416";
            current-speed = <115200>;
            enable-gpios = <&pio PG 10 GPIO_ACTIVE_HIGH>;
        };
    };
...
```

## drivers/soc/sunxi/Kconfig
```kconfig
# SPDX-License-Identifier: GPL-2.0-only
#
# Allwinner sunXi SoC drivers
#

config SUNXI_MBUS
	bool
	default ARCH_SUNXI
	depends on ARM || ARM64
	help
	  Say y to enable the fixups needed to support the Allwinner
	  MBUS DMA quirks.

config SUNXI_SRAM
	bool
	default ARCH_SUNXI
	select REGMAP_MMIO
	help
	  Say y here to enable the SRAM controller support. This
	  device is responsible on mapping the SRAM in the sunXi SoCs
	  whether to the CPU/DMA, or to the devices.

config WB_RAMOOPS_PANIC_RESET
	bool "Wiren Board: SoC watchdog warm reset on panic when ramoops is present"
	depends on ARCH_SUNXI && PSTORE_RAM
	help
	  On panic, arm the (otherwise idle) SoC watchdog so a Wiren
	  Board 7 (Allwinner R40/A40i) or Wiren Board 8 (Allwinner
	  T507/H616) takes a DRAM-preserving warm reset and the panic
	  log survives in the ramoops region for the bootloader to
	  persist. Arms itself only when a ramoops reserved-memory
	  node is present.
```
