/dts-v1/;
#include "sun8i-r40-wirenboard733.dts"
#include "sun8i-r40-wirenboard7xx-38071cb.dtsi"

/ {
	model = "Wiren Board rev. 7.3.4 (A40i) 38071cb";
	compatible = "wirenboard,wirenboard-734-38071cb", "wirenboard,wirenboard-7xx-38071cb", "wirenboard,wirenboard-7xx", "allwinner,sun8i-r40";
};
