/dts-v1/;
#include "sun8i-r40-wirenboard72x.dtsi"
#include "sun8i-r40-wirenboard72x-eui-eeprom.dtsi"

/ {
	model = "Wiren Board rev. 7.2.0 (A40i)";
	compatible = "wirenboard,wirenboard-720-initram", "wirenboard,wirenboard-720", "wirenboard,wirenboard-700", "allwinner,sun8i-r40";
};

/*
	Since wb7.2+, this port set for lower usb speed (for more stable debug-network).
	While performing init-magic, we need max possible usb speed.
*/
&usb_otg {
	/delete-property/ maximum-speed;
};
